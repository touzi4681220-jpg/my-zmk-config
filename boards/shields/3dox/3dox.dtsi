#include <dt-bindings/zmk/matrix_transform.h>

/ {
    chosen {
        zmk,kscan = &kscan0;
        zmk,matrix-transform = &default_transform;
    };

    default_transform: keymap_transform_0 {
        compatible = "zmk,matrix-transform";
        columns = 5;
        rows = 15;
        map = <
            // 你的 RC() 映射列表
            // 例如：RC(0,0) RC(0,1) RC(0,2) ...
        >;
    };

    kscan0: kscan {
        compatible = "zmk,kscan-gpio-matrix";
        // 根据你的原理图填写
        row-gpios = <&pro_micro 4 (GPIO_ACTIVE_LOW | GPIO_PULL_UP)>,
                    // ... 其他行引脚
                    ;
        col-gpios = <&pro_micro 5 GPIO_ACTIVE_LOW>,
                    // ... 其他列引脚
                    ;
    };
};
