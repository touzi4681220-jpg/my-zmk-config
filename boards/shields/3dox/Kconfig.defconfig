## boards/shields/3dox/Kconfig.defconfig
```kconfig
if SHIELD_3DOX_LEFT
config ZMK_KEYBOARD_NAME
    default "3dox"
config ZMK_SPLIT_BLE_ROLE_CENTRAL
    default y
endif

if SHIELD_3DOX_RIGHT
config ZMK_KEYBOARD_NAME
    default "3dox"
endif
```

## boards/shields/3dox/Kconfig.shield
```kconfig
config SHIELD_3DOX_LEFT
    def_bool $(shields_list_contains,3dox_left)

config SHIELD_3DOX_RIGHT
    def_bool $(shields_list_contains,3dox_right)
```
